## CMakeLists.txt
```
cmake_minimum_required(VERSION 3.20.0)

find_package(Zephyr)
project(my_zephyr_app)

target_sources(app PRIVATE src/main.c PRIVATE src/handle_data.c PRIVATE src/complementary_filter.c)
```

## prj.conf
```kconfig
CONFIG_SHELL=y
CONFIG_SHELL_PROMPT_UART="(zephyr) "
CONFIG_MAIN_THREAD_PRIORITY=15
CONFIG_LED=y
CONFIG_SENSOR=y
CONFIG_LOG=y
```

## boards/disco_l475_iot1.overlay
```dts
/ {
  leds {
    blue_led: led_4 {
      gpios = < &gpioc 0x9 (GPIO_ACTIVE_LOW | GPIO_OPEN_DRAIN)>;
      label = "User LD4";
    };
  };
};
```

## src/main.c
```c
#include <inttypes.h>
#include <zephyr/device.h>
#include <zephyr/drivers/gpio.h>
#include <zephyr/drivers/i2c.h>
#include <zephyr/kernel.h>
#include <zephyr/logging/log.h>
#include <zephyr/sys/util.h>
#include <zephyr/sys_clock.h>

#include "handle_data.h"

/*
 * Getting the accelerometer from the device tree
 */
#define ACCELEROMETER_NODE DT_ALIAS(accel0)

struct i2c_dt_spec accelerometer_i2c = I2C_DT_SPEC_GET(ACCELEROMETER_NODE);

const struct gpio_dt_spec accelerometer_irq_gpio =
    GPIO_DT_SPEC_GET(ACCELEROMETER_NODE, irq_gpios);

/*
 * Sensor interrupt callback data
 */
static struct gpio_callback sensor_isr_data;

/*
 * Initializing a workqueue thread to handle new data
 */
#define MY_STACK_SIZE 512
#define MY_PRIORITY 13

K_THREAD_STACK_DEFINE(my_stack_area, MY_STACK_SIZE);

static struct k_work_q my_work_q;


static void sensor_isr(const struct device *dev, struct gpio_callback *cb,
                       uint32_t pins);
static void configure_accelerometer();
static int setup_gpio_irq_and_workqueue();

LOG_MODULE_REGISTER(accelerometer, LOG_LEVEL_INF);

int main(void) {
  if (!i2c_is_ready_dt(&accelerometer_i2c)) {
    LOG_ERR("Accelerometer isn't ready\n");
    return 1;
  }

  if (!setup_gpio_irq_and_workqueue()) {
    return 1;
  }

  configure_accelerometer();

  return 0;
}

/*
 * Accelerometer Interrupt Handler
 * Submit a handle new data job to the workqueue
 */
static void sensor_isr(const struct device *dev, struct gpio_callback *cb,
                       uint32_t pins) {
  k_work_submit_to_queue(&my_work_q, &handle_new_data_job);
}

static void configure_accelerometer() {
  // reset the accelerometer device
  // set bit 0 of register 12 (CTRL3_C) to 1
  uint8_t bit_mask = 1;
  uint8_t value = 1;
  i2c_reg_update_byte_dt(&accelerometer_i2c, 0x12, bit_mask, value);

  // disable high performance mode for the accelerometer
  // set bit 4 of register 15 (CTRL6_C) to 1
  bit_mask = 1 << 4;
  value = 1 << 4;
  i2c_reg_update_byte_dt(&accelerometer_i2c, 0x15, bit_mask, value);

  // set output data rate of accelerometer at ACCELEROMETER_ODR Hz
  // set bits [7:4] of register 10 (CTRL1_XL) to 0011
  bit_mask = 0xF << 4;
  value = 0x3 << 4;
  i2c_reg_update_byte_dt(&accelerometer_i2c, 0x10, bit_mask, value);

  // disable high performance mode for the gyroscope
  // set bit 7 of register 16 (CTRL7_G) to 1
  bit_mask = 1 << 7;
  value = 1 << 7;
  i2c_reg_update_byte_dt(&accelerometer_i2c, 0x16, bit_mask, value);

  // set output data rate of gyroscope at GYROSCOPE_ODR Hz
  // set bits [7:4] of register 11 (CTRL2_G) to  0011
  bit_mask = 0xF << 4;
  value = 0x3 << 4;
  i2c_reg_update_byte_dt(&accelerometer_i2c, 0x11, bit_mask, value);

  // allowing the interruption Accelerometer Data Ready on INT1
  // set bit 0 of register 0D (INT1_CTRL) to 1
  bit_mask = 0x3;
  value = 0x3;
  i2c_reg_update_byte_dt(&accelerometer_i2c, 0x0D, bit_mask, value);
}

static int setup_gpio_irq_and_workqueue() {
  /*
   * Checking that the GPIO is ready
   * configuring it as an input with an interrupt.
   */
  if (!device_is_ready(accelerometer_irq_gpio.port)) {
    LOG_ERR("GPIO is not ready\n");
    return 0;
  }

  if (gpio_pin_configure_dt(&accelerometer_irq_gpio, GPIO_INPUT)) {
    LOG_ERR("GPIO configured as input\n");
    return 0;
  }

  if (gpio_pin_interrupt_configure_dt(&accelerometer_irq_gpio,
                                      GPIO_INT_EDGE_RISING)) {
    LOG_ERR("GPIO interruption configured\n");
    return 0;
  }

  // Adding a callback to select the interrupt handler.
  gpio_init_callback(&sensor_isr_data, sensor_isr,
                     BIT(accelerometer_irq_gpio.pin));

  if (gpio_add_callback(accelerometer_irq_gpio.port, &sensor_isr_data)) {
    LOG_ERR("Callback couldn't be added\n");
    return 0;
  }

  /*
   * Initializing a workqueue job to execute the blocking I2C
   * operation to handle the new data
   */
  k_work_init(&handle_new_data_job, handle_new_data);

  k_work_queue_init(&my_work_q);

  k_work_queue_start(&my_work_q, my_stack_area,
                     K_THREAD_STACK_SIZEOF(my_stack_area), MY_PRIORITY, NULL);

  LOG_INF("Irq setup was successful\n");
  return 1;
}
```

## src/blink_led.c
```c
#include <zephyr/kernel.h>
#include <zephyr/device.h>
#include <zephyr/drivers/gpio.h>
#include <zephyr/sys_clock.h>
#include <zephyr/sys/util.h>
#include <zephyr/sys/printk.h>
#include <inttypes.h>

#ifndef BLINK_LED_H
#define BLINK_LED_H
#include "blink_led.h"
#endif

#define MSGQ_CHECK_PERIOD K_MSEC(MSGQ_CHECK_PERIOD_MS)

extern struct k_msgq blink_period_msgq;

static struct gpio_dt_spec led = GPIO_DT_SPEC_GET_OR(DT_ALIAS(led0), gpios,
                                                     {0});

static void check_msgq_during_half_period();
static int get_message(blink_half_period_ms_t *blink_period_ptr);
static int setup_led_device();

void led_main()
{
  if (!setup_led_device())
    return;

  // Blinking the led and checking the message queue
  while (1)
  {
    gpio_pin_set_dt(&led, 1);
    check_msgq_during_half_period();
    gpio_pin_set_dt(&led, 0);
    check_msgq_during_half_period();
  }
}

/*
 * Check the message queue every MSGQ_CHECK_PERIOD
 * for a total duration of a half period.
 * Update curr_blink_period and break if necessary.
 */
static void check_msgq_during_half_period()
{
  static blink_half_period_ms_t curr_blink_period = SLOW_BLINK;
  static blink_half_period_ms_t new_blink_period;
  
  new_blink_period = curr_blink_period;

  for (int i = 0; i < curr_blink_period / MSGQ_CHECK_PERIOD_MS; i++)
  {
    // Check the message queue every MSGQ_CHECK_PERIOD
    k_sleep(MSGQ_CHECK_PERIOD);
    int new_msg = get_message(&new_blink_period);
    if (new_msg && curr_blink_period != new_blink_period)
    {
      curr_blink_period = new_blink_period;
      break;
    }
  }
}

/*
 * Put the content of a message in blink_period_ptr.
 * Return 1 if successful.
 */
static int get_message(blink_half_period_ms_t *blink_period_ptr)
{
  return !k_msgq_get(&blink_period_msgq, blink_period_ptr, K_NO_WAIT);
}

/*
 * Setup the led device.
 * Return 1 if successful
 */
static int setup_led_device()
{
  if (!gpio_is_ready_dt(&led))
  {
    printk("Error : LED device %s is not ready; ignoring it\n",
           led.port->name);
    return 0;
  }
  else if (!led.port)
  {
    printk("Error : LED port not found\n");
    return 0;
  }
  else
  {
    int ret = gpio_pin_configure_dt(&led, GPIO_OUTPUT);
    if (ret != 0)
    {
      printk("Error %d: failed to configure LED device %s pin %d\n",
             ret, led.port->name, led.pin);
      return 0;
    }
    else
    {
      printk("Set up LED at %s pin %d\n", led.port->name, led.pin);
      return 1;
    }
  }
}
```

## src/blink_led.h
```c
#define MSGQ_CHECK_PERIOD_MS 100

/*
 * Blink period.
 * Values should be a multiple of MSGQ_CHECK_PERIOD_MS.
 */
typedef enum {
  FAST_BLINK=200,
  SLOW_BLINK=600,
} blink_half_period_ms_t;

extern void led_main();
```

## src/complementary_filter.c
```c
#include "complementary_filter.h"

#include <inttypes.h>
#include <math.h>
#include <zephyr/device.h>
#include <zephyr/drivers/gpio.h>
#include <zephyr/drivers/i2c.h>
#include <zephyr/kernel.h>
#include <zephyr/logging/log.h>
#include <zephyr/sys/util.h>
#include <zephyr/sys_clock.h>

#include "blink_leds.h"

#define MSGQ_BUFFER_SIZE 1
#define MSGQ_UPDATE_PERIOD K_MSEC(MSGQ_CHECK_PERIOD_MS)

#define LED_THREAD_STACK_SIZE 512
#define LED_THREAD_PRIORITY 15

/*
 * Define a secondary thread.
 */
static struct k_thread led_thread;

/*
 * Define the message queue and its buffer.
 */
struct k_msgq blink_period_msgq;
static uint8_t
    blink_period_msgq_buffer[sizeof(blink_half_period_ms_t) * MSGQ_BUFFER_SIZE];

K_THREAD_STACK_DEFINE(led_thread_stack, LED_THREAD_STACK_SIZE);

static blink_half_period_ms_t get_blink_half_period_from_measure(
    int board_tilt);
static void update_msgq_if_necessary(blink_half_period_ms_t new_blink_period);
static void send_message();

protected_variable tilt_from_acceleration;
protected_variable tilt_change_from_gyroscope;

LOG_MODULE_REGISTER(complementary_filter, LOG_LEVEL_INF);

void init_complementary_filter() {
  k_mutex_init(&tilt_from_acceleration.mutex);
  k_mutex_init(&tilt_change_from_gyroscope.mutex);

  // Initializing the message queue
  k_msgq_init(&blink_period_msgq, blink_period_msgq_buffer,
              sizeof(blink_half_period_ms_t), MSGQ_BUFFER_SIZE);

  // Spawning a thread for the led task
  k_thread_create(&led_thread, led_thread_stack, LED_THREAD_STACK_SIZE,
                  led_main, NULL, NULL, NULL, LED_THREAD_PRIORITY, 0,
                  K_NO_WAIT);
}
void compute_board_attitude_with_filter() {
  static double complementary_coefficient = 0.98;
  static double tilt = 0;

  k_mutex_lock(&tilt_change_from_gyroscope.mutex, K_FOREVER);
  tilt = tilt_change_from_gyroscope.value * (1 - complementary_coefficient);
  k_mutex_unlock(&tilt_change_from_gyroscope.mutex);

  LOG_DBG("after gyro : %g\n", tilt);

  k_mutex_lock(&tilt_from_acceleration.mutex, K_FOREVER);
  tilt += tilt_from_acceleration.value * complementary_coefficient;
  k_mutex_unlock(&tilt_from_acceleration.mutex);

  LOG_DBG("%g\n", tilt * 180 / 3.1415926535);

  blink_half_period_ms_t blink_period =
      get_blink_half_period_from_measure((int)(tilt * 180 / 3.1415926535));
  update_msgq_if_necessary(blink_period);
}

static blink_half_period_ms_t get_blink_half_period_from_measure(
    int board_tilt) {
  if (board_tilt < 5) {
    return VERY_SLOW_BLINK;
  } else if (board_tilt < 30) {
    return SLOW_BLINK;
  } else if (board_tilt < 55) {
    return REGULAR_BLINK;
  } else if (board_tilt < 80) {
    return FAST_BLINK;
  } else {
    return VERY_FAST_BLINK;
  }
}

static void update_msgq_if_necessary(blink_half_period_ms_t new_blink_period) {
  static blink_half_period_ms_t prev_blink_period = VERY_SLOW_BLINK;
  static blink_half_period_ms_t curr_blink_period;

  curr_blink_period = new_blink_period;
  if (prev_blink_period != curr_blink_period) {
    send_message(&curr_blink_period);
  }
  prev_blink_period = curr_blink_period;
}

static void send_message(blink_half_period_ms_t *blink_period_ptr) {
  // if the message queue is full
  if (k_msgq_num_free_get(&blink_period_msgq) == 0) {
    k_msgq_purge(&blink_period_msgq);
  }
  k_msgq_put(&blink_period_msgq, blink_period_ptr, K_NO_WAIT);
}
```

## src/handle_data.c
```c
#include "handle_data.h"

#include <inttypes.h>
#include <math.h>
#include <zephyr/device.h>
#include <zephyr/drivers/gpio.h>
#include <zephyr/drivers/i2c.h>
#include <zephyr/kernel.h>
#include <zephyr/logging/log.h>
#include <zephyr/sys/util.h>
#include <zephyr/sys_clock.h>

/*
 * Using useful device tree structs.
 */
extern struct i2c_dt_spec accelerometer_i2c;
extern const struct gpio_dt_spec accelerometer_irq_gpio;

/*
 * Workqueue job to handle the new data
 */
struct k_work handle_new_data_job;

/*
 * Linear acceleration register address and values
 */
static uint8_t acceleration_register_address = 0x28;
static int16_t acceleration_measure[3];
static uint8_t acceleration_register[6];

/*
 * Angular rate register address and values
 */
static char axis_label[2] = {'X', 'Y'};
static uint8_t angular_rate_register_address = 0x22;
static uint8_t angular_rate_register[4];
static int16_t angular_rate_measure[2];

void handle_new_data();
static void compute_board_tilt_from_acceleration();
static void compute_board_tilt_from_angular_rate();

LOG_MODULE_REGISTER(accelerometer_data, CONFIG_LOG_DEFAULT_LEVEL);

void handle_new_data() {
  while (gpio_pin_get_dt(&accelerometer_irq_gpio)) {
    // read the status register 1E (STATUS_REG)
    // bit 0 : Accelerometer New Data
    // bit 1 : Gyroscope New Data
    uint8_t status_reg;
    i2c_reg_read_byte_dt(&accelerometer_i2c, 0x1E, &status_reg);

    if (status_reg & 0x1) {
      compute_board_tilt_from_acceleration();
    }

    if (status_reg & 0x2) {
      compute_board_tilt_from_angular_rate();
    }
  }
}

static void compute_board_tilt_from_acceleration() {
  // read the contents of all 6 acceleration registers
  // put their contents in a buffer
  i2c_write_read_dt(&accelerometer_i2c, &acceleration_register_address, 1,
                    acceleration_register, 6);

  // get the acceleration measures from register contents
  // compute the norm of the acceleration
  int32_t squared_norm = 0;
  for (int i = 0; i < 3; i++) {
    uint16_t acceleration =
        acceleration_register[i * 2] | (acceleration_register[i * 2 + 1] << 8);
    acceleration_measure[i] = (int16_t)acceleration;
    squared_norm += acceleration_measure[i] * acceleration_measure[i];
  }
  double norm = sqrt(squared_norm);
  // compute the tilt angle
  double tilt_angle = acos(acceleration_measure[2] / norm) * 180 / 3.1415926535;
  LOG_PRINTK("tilt angle : %g° (from accelerometer)\n\n", tilt_angle);
}

static void compute_board_tilt_from_angular_rate() {
  static double angle[2] = {0, 0};

  // read the contents of the 4 needed angular rate registers
  // put their contents in a buffer
  i2c_write_read_dt(&accelerometer_i2c, &angular_rate_register_address, 1,
                    angular_rate_register, 4);

  // integrate the angular rate
  for (int i = 0; i < 2; i++) {
    uint16_t angular_rate =
        angular_rate_register[i * 2] | (angular_rate_register[i * 2 + 1] << 8);
    angular_rate_measure[i] = (int16_t)angular_rate;

    // the scale of the measure is +/- 250 dps, the frequency is GYROSCOPE_ODR
    // Hz
    angle[i] += (float)(angular_rate_measure[i]) / (1 << 15) * 250 /
                GYROSCOPE_ODR / 180 * 3.1415926535;
  }
  LOG_DBG("(Rate measures %hd %hd)\n", angular_rate_measure[0],
          angular_rate_measure[1]);

  double board_tilt = acos(cos(angle[0]) * cos(angle[1]));
  LOG_PRINTK(
      "From angular rates integration %c : %g°, %c : "
      "%g°\ttilt angle : %g°\n\n",
      axis_label[0], angle[0] / 3.1415926535 * 180, axis_label[1],
      angle[1] / 3.1415926535 * 180, board_tilt / 3.1415926535 * 180);
}
```

## src/handle_data.h
```c
#ifndef HANDLE_DATA_H
#define HANDLE_DATA_H

#define ACCELEROMETER_ODR 52
#define GYROSCOPE_ODR 1660

extern void handle_new_data();

extern void init_filter_workq();

#endif
```
